## matter_light/main/Kconfig.projbuild
```kconfig
menu "Example Configuration"

    config ESP_WIFI_SSID
        string "WiFi SSID"
        default ""
        help
            SSID (network name) for the WiFi connection.
            Leave empty to use Matter commissioning (WiFi credentials
            provided via BLE during pairing).

    config ESP_WIFI_PASSWORD
        string "WiFi Password"
        default ""
        help
            WiFi password (if ESP_WIFI_SSID is set).

endmenu
```

## multi_periph/main/Kconfig.projbuild
```kconfig
menu "Demo App Configuration"

choice APP_PROFILE_CHOICE
    prompt "Application run profile"
    default APP_PROFILE_LCD_UI
    help
        Select one startup profile for app_main.

config APP_PROFILE_LCD_UI
    bool "LCD + LVGL UI"

config APP_PROFILE_SENSOR_OLED
    bool "OLED + DHT11"

config APP_PROFILE_WS2812
    bool "WS2812 effects"

config APP_PROFILE_EXTI_LED
    bool "EXTI + LED"

endchoice

config APP_TOUCH_SPI_MODE
    int "XPT2046 SPI mode"
    range 0 3
    default 0
    help
        SPI mode for XPT2046 touch controller. If X/Y are fixed or abnormal,
        try modes 0..3.

menu "Optional Peripheral Features"

config APP_FEATURE_UART1
    bool "Enable UART1 feature"
    default n
    help
        Enable UART1-related logic. This is used by compile-time pin
        conflict guards.

config APP_FEATURE_CAMERA
    bool "Enable camera feature"
    default n
    help
        Enable OV2640 camera-related logic. This is used by compile-time pin
        conflict guards.

config APP_FEATURE_TF_SD
    bool "Enable TF/MicroSD feature"
    default n
    help
        Enable TF card-related logic. This is used by compile-time pin
        conflict guards.

endmenu

endmenu
```

## qa_volc/sdkconfig.defaults
```kconfig
CONFIG_PARTITION_TABLE_CUSTOM=y
CONFIG_PARTITION_TABLE_CUSTOM_FILENAME="partitions.csv"
CONFIG_ESPTOOLPY_FLASHSIZE_16MB=y
CONFIG_IDF_TARGET="esp32s3"

# PSRAM (Octal, 8MB)
CONFIG_SPIRAM=y
CONFIG_SPIRAM_IGNORE_NOTFOUND=y
CONFIG_SPIRAM_MODE_OCT=y
CONFIG_SPIRAM_TYPE_AUTO=y
CONFIG_SPIRAM_USE_CAPS_ALLOC=y

# LVGL large font support (required for Chinese font)
CONFIG_LV_FONT_FMT_TXT_LARGE=y

# TLS: skip server cert verification for Volcengine HTTPS API
CONFIG_ESP_TLS_INSECURE=y
CONFIG_ESP_TLS_SKIP_SERVER_CERT_VERIFY=y

# ark.cn-beijing.volces.com requires TLS 1.3 + TLS_AES_256_GCM_SHA384
CONFIG_MBEDTLS_SSL_PROTO_TLS1_3=y

# Allocate mbedTLS large structures (handshake params ~16KB) from PSRAM.
# ESP32-S3 has 8MB PSRAM — TLS structures fit easily and PSRAM is cacheable.
# Fixes "alloc(16717 bytes) failed" on repeated HTTPS calls due to internal RAM fragmentation.
CONFIG_MBEDTLS_EXTERNAL_MEM_ALLOC=y

# Reduce internal RAM pressure from mbedTLS features we don't need
# (all three tasks are HTTPS clients, no server, no renegotiation)
# CONFIG_MBEDTLS_SSL_KEEP_PEER_CERTIFICATE is not set
# CONFIG_MBEDTLS_SERVER_SSL_SESSION_TICKETS is not set
# CONFIG_MBEDTLS_SSL_RENEGOTIATION is not set

# Dev debug: mbedtls TLS handshake logging (remove for production)
CONFIG_MBEDTLS_DEBUG=y
CONFIG_MBEDTLS_DEBUG_LEVEL_WARN=y
```

## xiaozhi/main/Kconfig.projbuild
```kconfig
menu "XiaoZhi Config"

    config XIAOZHI_WIFI_SSID
        string "Wi-Fi SSID"
        default "wfeng"

    config XIAOZHI_WIFI_PASSWORD
        string "Wi-Fi Password"
        default "wf05430543"

    config XIAOZHI_WS_URL
        string "XiaoZhi WebSocket URL"
        default "wss://api.tenclass.net/xiaozhi/v1/"

    config XIAOZHI_OTA_URL
        string "XiaoZhi OTA URL"
        default "https://api.tenclass.net/xiaozhi/ota/"

    config XIAOZHI_ACCESS_TOKEN
        string "XiaoZhi Access Token"
        default ""

    config XIAOZHI_ENABLE_LCD_STATUS
        bool "Enable XiaoZhi LCD status UI"
        default y

    config XIAOZHI_INPUT_GAIN_DB
        int "Microphone gain (dB)"
        range 0 36
        default 24

    config XIAOZHI_OUTPUT_VOLUME
        int "Speaker volume (0-100)"
        range 0 100
        default 100

endmenu
```
